#include <U8glib.h>

#include <Rtc_Pcf8563.h>

#include <Wire.h>

#define INTERVAL_Time 1000

#define INTERVAL_OLED 1000
#include "OurSpark.h"
#include <IRremote.h>
#include <Servo.h>    // 声明调用Servo.h库
Servo myservo1;        // 创建一个舵机对象
Servo myservo2;  
int recvPin = 4;//定义红外接收器的引脚为3
IRrecv irrecv(recvPin);
decode_results results;
int pos = 0;          // 变量pos用来存储舵机位置
long KEY_CODE_A = 0x1FE807F;
long KEY_CODE_B = 0x1FE40BF;
long KEY_CODE_C=0x1FEC03F;

ColorLEDController LEDController1(2, 8);  //第一个2表示最大级联ColorLED个数，第二个6表示使用D6口。





#define setFont_L u8g.setFont(u8g_font_courB14)

#define setFont_M u8g.setFont(u8g_font_fixed_v0r)

#define setFont_S u8g.setFont(u8g_font_chikitar)



#define buzzer_pin 2
#include <Servo.h>    // 声明调用Servo.h库
Servo myservo;        // 创建一个舵机对象


int micPin = A2; 

int micValue=0;

bool isRoar=false;



U8GLIB_SSD1306_128X64 u8g(U8G_I2C_OPT_NONE);//定义OLED连接方式



unsigned long Time_millis = millis();

unsigned long OLEDShowTime = millis();



int timeHH, timeMM, timeSS;

int year,month,day;

String stringDate;

String stringTime;

Rtc_Pcf8563 rtc;





const unsigned char u8g_logo_bits[] U8G_PROGMEM = {

  0x00,0x00,0x00,0x00,0x00,0x00,0x00,0x00,0x00,0x00,0x00,0x00, 

  0x00,0x00,0x00,0x00,0x00,0x00,0x00,0x00,0x00,0x00,0x00,0x00,
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  0x00,0x00,0x00,0x00,0x00,0x00,0x00,0x00,0x00,0x00,0x00,0x00 };



void osd_logo()     

{

  u8g.firstPage();  

  do 

  {

    u8g.drawXBMP( 0, 32, 128, 18, u8g_logo_bits);

  } 

  while( u8g.nextPage() );

}



void setup() {

  Serial.begin(9600);

  pinMode(buzzer_pin,OUTPUT);

  pinMode(micPin,INPUT);
 myservo2.attach(7);
myservo1.attach(6);
  irrecv.enableIRIn(); // 初始化红外接收器

  osd_logo();

  delay(3000);



  initTime();

}



void loop() {

  updateMic();

  updateTime();

  updateOLED();

  updateAlarm();
hongwaiduoji();
}





void initTime() {

  rtc.initClock();

  //set a time to start with.

  //day, weekday, month, century(1=1900, 0=2000), year(0-99)

  rtc.setDate(21, 5, 12, 0, 18);

  //hr, min, sec

  rtc.setTime(6, 58, 0);

}





void getCurrentTime() {



  rtc.formatDate();

  rtc.formatTime();



  timeHH=rtc.getHour();

  timeMM=rtc.getMinute();

  timeSS=rtc.getSecond();

  year=2000+rtc.getYear();

  month=rtc.getMonth();

  day=rtc.getDay();





  stringDate=String(year);

  stringDate+="/";

  stringDate+=month;

  stringDate+="/";

  stringDate+=day;



  stringTime=String(timeHH);

  stringTime+=":";

  stringTime+=timeMM;

  stringTime+=":";

  stringTime+=timeSS;



}



void updateTime() {

  //update GPS and UT during INTERVAL_GPS

  if (Time_millis > millis()) Time_millis = millis();

  if(millis()-Time_millis>INTERVAL_Time) {

    getCurrentTime();

    Time_millis = millis();

  } 

}



void updateOLED() {

  //OLED display

  if (OLEDShowTime > millis()) OLEDShowTime = millis();

  if(millis()-OLEDShowTime>INTERVAL_OLED) {

    //convert RA DEC to AZ Alt

    OLEDShow(); //调用显示库

    OLEDShowTime = millis();

  } 

}



void OLEDShow() {

    u8g.firstPage();

    do {

      setFont_L;

      u8g.setPrintPos(5, 20);

      u8g.print(stringDate);



      u8g.setPrintPos(5, 40);

      u8g.print(stringTime);



    } while( u8g.nextPage() );

}





void updateAlarm() {

  if(timeHH==7&&timeMM<5) 
{ myservo2.write(180);           // 给舵机写入角度   
      if(micValue>736) {

      isRoar=true;

    }

    if(isRoar) {

      noTone(buzzer_pin);

    } else {

      tone(buzzer_pin,500); //在端口输出频率

    }

  } else {

    isRoar=false;

    noTone(buzzer_pin);

  }

}
void hongwaiduoji()
{   if (irrecv.decode(&results)) {
    Serial.println(results.value, HEX);//以16进制换行输出接收代码
    Serial.println();//为了便于观看输出结果增加一个空行
    irrecv.resume(); // 接收下一个值
  }

  //按下１键的事件
  if (results.value == KEY_CODE_A ) {
       
      for(pos = 0; pos < 180; pos += 1){    // 舵机从0°转到180°，每次增加1°          
      myservo1.write(pos);           // 给舵机写入角度   
      delay(15);                    // 延时15ms让舵机转到指定位置
   }
    
      
   }
  if (results.value == KEY_CODE_B ) {
       
 LEDController1.ShowColor(0,255,250,205); //第一个参数表示点亮0号灯，让其显示红光
  delay(1000);  //延迟1秒输出

    } 
  if (results.value == KEY_CODE_C ) {
       
 LEDController1.ShowColor(0,0,0,0);
  delay(1000);  //延迟1秒输出    
      
   }  }

void updateMic() {

  micValue = analogRead(micPin);

  //value = map(micValue, 0, 1023, 0, 255);

  Serial.println(micValue);

}
